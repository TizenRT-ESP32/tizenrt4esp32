## build/configs/esp32_board/bringup/defconfig
```kconfig
# TinyAra Configuration
#

#
# Hardware Configuration
#

#
# Chip Selection
#
CONFIG_ARCH_BOARD_ESP32CORE=y
CONFIG_ARCH_BOARD="esp32_board"
CONFIG_ARCH_CHIP_ESP32=y
CONFIG_ARCH_CHIP="esp32"
CONFIG_ARCH_STACKDUMP=y
CONFIG_ARCH_XTENSA=y
CONFIG_ARCH="xtensa"
CONFIG_ARCH_FAMILY_LX6=y
CONFIG_ARCH_NOINTC=y
CONFIG_ARCH_LOWPUTC=y
CONFIG_BOARD_LOOPSPERMSEC=16717
CONFIG_SPI=y


#
# Boot Memory Configuration
#
CONFIG_MM_REGIONS=2
CONFIG_RAM_START=0x40080000
CONFIG_RAM_SIZE=131072


#
# Start time
#
CONFIG_START_DAY=6
CONFIG_START_MONTH=12
CONFIG_START_YEAR=2011


#
# Application configuration
#
CONFIG_APPS_DIR="../apps"
CONFIG_FRAMEWORK_DIR="../framework"
CONFIG_TOOLS_DIR="../tools"


#
# Standard C Library Options
#
CONFIG_STDIO_BUFFER_SIZE=64
CONFIG_STDIO_LINEBUFFER=y
CONFIG_NUNGET_CHARS=2
CONFIG_LIB_HOMEDIR="/"
CONFIG_LIBM=y


#
# Tasks and Scheduling
#
CONFIG_INIT_ENTRYPOINT=y
CONFIG_RR_INTERVAL=100
CONFIG_TASK_NAME_SIZE=31
CONFIG_MAX_TASKS=32
CONFIG_SCHED_HAVE_PARENT=y
# CONFIG_SCHED_CHILD_STATUS is not set
CONFIG_SCHED_WAITPID=y


#
# Binary Output Formats
#
# CONFIG_INTELHEX_BINARY is not set
# CONFIG_MOTOROLA_SREC is not set
# CONFIG_RAW_BINARY is not set
# CONFIG_UBOOT_UIMAGE is not set
# CONFIG_DOWNLOAD_IMAGE is not set
# CONFIG_SMARTFS_IMAGE is not set
CONFIG_ESP32_PARTITION=y


#
# Board-Specific Options
#
CONFIG_ESP32_TRACEMEM_RESERVE_DRAM=0
CONFIG_ESP32_BT_RESERVE_DRAM=0
CONFIG_ESP32_ULP_COPROC_RESERVE_MEM=0
CONFIG_ESP32_DEFAULT_CPU_FREQ_MHZ=160
CONFIG_DEBUG_ALERT=y


# Application entry point list
#
# CONFIG_ENTRY_MANUAL is not set
CONFIG_ENTRY_HELLO=y
# CONFIG_ENTRY_TLS_CLIENT is not set
# CONFIG_ENTRY_TLS_SERVER is not set
CONFIG_USER_ENTRYPOINT="hello_main"
CONFIG_BUILTIN_APPS=y
CONFIG_EXAMPLES_HELLO=y


#
# Pthread Options
#
CONFIG_PTHREAD_MUTEX_TYPES=y
# CONFIG_PTHREAD_MUTEX_ROBUST is not set
CONFIG_PTHREAD_MUTEX_UNSAFE=y
# CONFIG_PTHREAD_MUTEX_BOTH is not set
CONFIG_NPTHREAD_KEYS=4
CONFIG_NPTHREAD_DESTRUCTOR_ITERATIONS=4
# CONFIG_PTHREAD_CLEANUP is not set
# CONFIG_CANCELLATION_POINTS is not set
CONFIG_USERMAIN_STACKSIZE=2048
CONFIG_IDLETHREAD_STACKSIZE=1024
CONFIG_PTHREAD_STACK_MIN=256
CONFIG_PTHREAD_STACK_DEFAULT=2048


#
# Performance Monitoring
#
# CONFIG_SCHED_CPULOAD is not set
# CONFIG_SCHED_INSTRUMENTATION is not set


#
# Latency optimization
#
# CONFIG_SCHED_YIELD_OPTIMIZATION is not set


#
# Files and I/O
#
CONFIG_DEV_CONSOLE=y
# CONFIG_FDCLONE_DISABLE is not set
# CONFIG_FDCLONE_STDIO is not set
# CONFIG_SDCLONE_DISABLE is not set
CONFIG_NFILE_DESCRIPTORS=8
CONFIG_NFILE_STREAMS=8
CONFIG_NAME_MAX=32
# CONFIG_PRIORITY_INHERITANCE is not set
CONFIG_DISABLE_POLL=y
CONFIG_FS_PROCFS=y


#
# RTOS hooks
#
CONFIG_BOARD_INITIALIZE=y
# CONFIG_BOARD_INITTHREAD is not set
# CONFIG_SCHED_STARTHOOK is not set
CONFIG_SCHED_ATEXIT=y
CONFIG_SCHED_ONEXIT=y
CONFIG_SCHED_ONEXIT_MAX=1


#
# Signal Numbers
#
CONFIG_SIG_SIGUSR1=1
CONFIG_SIG_SIGUSR2=2
CONFIG_SIG_SIGALARM=3
CONFIG_SIG_SIGCHLD=4
CONFIG_SIG_SIGCONDTIMEDOUT=16
CONFIG_SIG_SIGWORK=17


#
# POSIX Message Queue Options
#
CONFIG_PREALLOC_MQ_MSGS=4
CONFIG_MQ_MAXMSGSIZE=600


#
# Work Queue Support
#
CONFIG_SCHED_WORKQUEUE=y
CONFIG_SCHED_WORKQUEUE_SORTING=y
CONFIG_SCHED_HPWORK=y
CONFIG_SCHED_HPWORKPRIORITY=224
CONFIG_SCHED_HPWORKPERIOD=50000
CONFIG_SCHED_HPWORKSTACKSIZE=2048
# CONFIG_SCHED_LPWORK is not set


#
# Shell
#
CONFIG_TASH=y
CONFIG_TASH_MAX_COMMANDS=32
# CONFIG_DEBUG_TASH is not set
# CONFIG_TASH_COMMAND_INTERFACE is not set
CONFIG_TASH_CMDTASK_STACKSIZE=4096
CONFIG_TASH_CMDTASK_PRIORITY=100


#
# System Libraries and Add-Ons
#
# CONFIG_SYSTEM_CLE is not set
# CONFIG_SYSTEM_CUTERM is not set
# CONFIG_SYSTEM_FOTA_HAL is not set
# CONFIG_SYSTEM_I2CTOOL is not set
# CONFIG_SYSTEM_INIFILE is not set

CONFIG_SYSTEM_PREAPP_INIT=y
CONFIG_SYSTEM_PREAPP_STACKSIZE=2048

# CONFIG_SYSTEM_INSTALL is not set
# CONFIG_SYSTEM_POWEROFF is not set
# CONFIG_SYSTEM_RAMTEST is not set
# CONFIG_SYSTEM_READLINE is not set
CONFIG_SYSTEM_INFORMATION=y
CONFIG_KERNEL_CMDS=y
CONFIG_FS_CMDS=y
CONFIG_FSCMD_BUFFER_LEN=32
CONFIG_ENABLE_DATE=y
CONFIG_ENABLE_ENV_GET=y
CONFIG_ENABLE_ENV_SET=y
CONFIG_ENABLE_ENV_UNSET=y
CONFIG_ENABLE_FREE=y
CONFIG_ENABLE_HEAPINFO=y
# CONFIG_ENABLE_IRQINFO is not set
CONFIG_ENABLE_KILL=y
CONFIG_ENABLE_KILLALL=y
CONFIG_ENABLE_PS=y
CONFIG_ENABLE_UPTIME=y
CONFIG_SYSTEM_VI=y
CONFIG_SYSTEM_VI_COLS=64
CONFIG_SYSTEM_VI_ROWS=16
CONFIG_SYSTEM_VI_DEBUGLEVEL=0

#
#Uart configuration
#
CONFIG_ESP32_UART=y
CONFIG_ESP32_UART0=y
CONFIG_UART0_SERIAL_CONSOLE=y
CONFIG_MCU_SERIAL=y
CONFIG_STANDARD_SERIAL=y
CONFIG_ARCH_HAVE_SERIAL_TERMIOS=y
CONFIG_ESP32_UART0_TXPIN=1
CONFIG_ESP32_UART0_RXPIN=3
CONFIG_UART0_RXBUFSIZE=256
CONFIG_UART0_TXBUFSIZE=256
CONFIG_UART0_BAUD=115200
CONFIG_UART0_BITS=8
CONFIG_UART0_PARITY=0
CONFIG_UART0_2STOP=0


#
# Clocks and Timers
#
CONFIG_ARCH_HAVE_TICKLESS=y
# CONFIG_SCHED_TICKLESS is not set
CONFIG_USEC_PER_TICK=9979
CONFIG_SYSTEM_TIME64=y
CONFIG_CLOCK_MONOTONIC=y
# CONFIG_JULIAN_TIME is not set
CONFIG_MAX_WDOGPARMS=2
CONFIG_PREALLOC_WDOGS=16
CONFIG_WDOG_INTRESERVE=4
CONFIG_PREALLOC_TIMERS=4

#For burning image
CONFIG_ESPTOOLPY_PORT="/dev/ttyUSB0"
CONFIG_ESPTOOLPY_BAUD=115200
CONFIG_ESPTOOLPY_FLASHMODE="dio"
CONFIG_ESPTOOLPY_FLASHFREQ="40m"
CONFIG_ESPTOOLPY_FLASHSIZE="2MB"
CONFIG_ESPTOOLPY_BEFORE="default_reset"
CONFIG_ESPTOOLPY_AFTER_RESET=y
CONFIG_ESPTOOLPY_AFTER="hard_reset"
```
